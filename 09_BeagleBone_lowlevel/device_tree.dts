/dts-v1/;
/plugin/;

#include <dt-bindings/interrupt-controller/irq.h>

/ {
    compatible = "ti,am335x-bone-black", "ti,am335x-bone", "ti,am33xx";

    fragment@0 {
        target = <&i2c2>;
        __overlay__ {
            compatible = "arg,i2c2-ll";

            #address-cells = <1>;
            #size-cells = <0>;

            /* Not Used */
            reg =   <0x44e00000 0x1000>,  /* CM_PER */
                    <0x44e10000 0x2000>,  /* CTRL_MODULE */
                    <0x4819c000 0x1000>;  /* I2C2 BASE */
            reg-names = "cm_per", "ctrl_module", "i2c2_base";

            bus-frequency = <100000>; /* default 100kHz */

            mpu6050: mpu6050@68 {
                compatible = "arg,kdr_mpu6050";
                reg = <0x68>;
                /* P9_23 == gpio1_17, P9_27 == gpio3_21 */
                interrupts-extended = <&gpio1 17 IRQ_TYPE_EDGE_FALLING>,
                                        <&gpio3 21 IRQ_TYPE_EDGE_FALLING>;
            };
        };
    };
};
